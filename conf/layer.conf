## conf/layer.conf
```bitbake
# We have a conf directory, append to BBPATH
BBPATH .= ":${LAYERDIR}"

# We have a recipes directory, add to BBFILES
BBFILES += "${LAYERDIR}/recipes*/*/*.bb ${LAYERDIR}/recipes*/*/*.bbappend"

BBFILE_COLLECTIONS += "meta-fixes"
BBFILE_PATTERN_meta-fixes := "^${LAYERDIR}/"
BBFILE_PRIORITY_meta-fixes = "10"

LAYERDEPENDS_meta-fixes = "core office-layer meta-misc"
```
